ENTRY(entry)
OUTPUT_FORMAT("binary")
phys = 0x0800;

SECTIONS
{
    . = phys;

    .entry              : { __entry_start = .;      *(.entry)   }
    .text               : { __text_start = .;       *(.text)    }
}